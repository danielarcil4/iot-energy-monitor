## firmware/esp32_energy_monitor/components/device/Kconfig
```kconfig
menu "Configuración de dispositivo"
    
    config NAME
        string "Nombre del dispositivo"
        default "nombre_del_dispositivo"
        help
            Introduce el nombre del dispositivo.

endmenu
```

## firmware/esp32_energy_monitor/components/mqtt_service/Kconfig
```kconfig
menu "Configuración de broker"
    
    config MQTT_BROKER
        string "Dirección del broker MQTT"
        default "broker_por_defecto"
        help
            Introduce la dirección del broker MQTT al que se conectará el ESP32.

    config MQTT_BROKER_PORT
        int "Puerto del broker MQTT"
        default 1883
        help
            Introduce el puerto del broker MQTT al que se conectará el ESP32.

endmenu
```

## firmware/esp32_energy_monitor/components/wifi/Kconfig
```kconfig
menu "Configuración de wifi"

    config WIFI_SSID
        string "Nombre de la red Wi-Fi (SSID)"
        default "tu_ssid_por_defecto"
        help
            Introduce el nombre de la red Wi-Fi a la que se conectará el ESP32.

    config WIFI_PASS
        string "Contraseña del Wi-Fi"
        default "tu_password_por_defecto"
        help
            Introduce la contraseña de la red Wi-Fi.

endmenu
```
